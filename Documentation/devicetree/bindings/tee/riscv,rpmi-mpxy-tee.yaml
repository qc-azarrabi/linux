## Documentation/devicetree/bindings/tee/riscv,rpmi-mpxy-tee.yaml
```yaml
# SPDX-License-Identifier: (GPL-2.0-only OR BSD-2-Clause)
%YAML 1.2
---
$id: http://devicetree.org/schemas/tee/riscv,rpmi-mpxy-tee.yaml#
$schema: http://devicetree.org/meta-schemas/core.yaml#

title: RISC-V RPMI TEE service group based message proxy

maintainers:
  - Jens Wiklander <jenswi@kernel.org>

description: |
  The RISC-V Platform Management Interface (RPMI) [1] defines a messaging
  protocol which is modular and extensible. The supervisor software can
  send/receive RPMI messages via the SBI MPXY extension [2] or some dedicated
  supervisor-mode RPMI transport.

  The RPMI specification [1] defines a TEE service group which is the RISC-V
  analog of Arm FF-A: OP-TEE and the rich execution environment (REE, i.e.
  Linux) are peer endpoints and the RPMI framework (machine mode firmware)
  mediates every message. Entering OP-TEE on a hart runs it on that hart until
  it responds, so the SBI implementation provides one SBI MPXY channel per
  hart and a node is described per CPU as a child of the corresponding CPU
  node.

  ===========================================
  References
  ===========================================

  [1] RISC-V Platform Management Interface (RPMI) v1.0 (or higher)
      https://github.com/riscv-non-isa/riscv-rpmi/releases

  [2] RISC-V Supervisor Binary Interface (SBI) v3.0 (or higher)
      https://github.com/riscv-non-isa/riscv-sbi-doc/releases

properties:
  compatible:
    const: riscv,rpmi-mpxy-tee

  riscv,sbi-mpxy-channel-id:
    $ref: /schemas/types.yaml#/definitions/uint32
    description:
      The SBI MPXY channel id used to reach the RPMI TEE service group for the
      parent CPU.

  interrupts:
    maxItems: 1
    description:
      Availability doorbell raised by OP-TEE to signal asynchronous
      notifications over the RPMI TEE signal bus. Optional; when absent
      asynchronous notification is disabled.

required:
  - compatible
  - riscv,sbi-mpxy-channel-id

additionalProperties: false

examples:
  - |
    cpus {
        #address-cells = <1>;
        #size-cells = <0>;

        cpu@0 {
            device_type = "cpu";
            reg = <0x0>;
            compatible = "riscv";
            riscv,isa = "rv64imafdc";
            mmu-type = "riscv,sv48";

            tee {
                compatible = "riscv,rpmi-mpxy-tee";
                riscv,sbi-mpxy-channel-id = <0x10>;
            };
        };
    };
...
```
